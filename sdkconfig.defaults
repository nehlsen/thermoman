## sdkconfig.defaults
```kconfig
### Required for Wifi provisioning to work
CONFIG_BT_ENABLED=y
### Required for FS to work
CONFIG_ESPTOOLPY_FLASHSIZE_4MB=y
CONFIG_PARTITION_TABLE_CUSTOM=y
CONFIG_PARTITION_TABLE_CUSTOM_FILENAME="partition_table.csv"

# Allow OTA over HTTP instead of only HTTPS
CONFIG_OTA_ALLOW_HTTP=y

# Enable Power Management
CONFIG_PM_ENABLE=y
CONFIG_FREERTOS_USE_TICKLESS_IDLE=y

# network stuff
CONFIG_LWIP_LOCAL_HOSTNAME="thermoman"
CONFIG_LWIP_DHCP_RESTORE_LAST_IP=y

################################################################################
# EBLi Stuff

CONFIG_EBLI_FS_ENABLE=y
CONFIG_EBLI_STATUS_ENABLE=y
CONFIG_EBLI_STATUS_LED_GPIO_NUM=2
CONFIG_EBLI_WIFI_ENABLE=y
CONFIG_EBLI_MQTT_ENABLE=y
CONFIG_EBLI_MQTT_DEFAULT_BROKER="mqtt-broker.lan"
CONFIG_EBLI_MQTT_DEFAULT_DEVICE_TOPIC="thermoman"
CONFIG_EBLI_MQTT_DEFAULT_GROUP_TOPIC="thermomans"
# CONFIG_EBLI_HTTP_ENABLE=y
CONFIG_EBLI_TIME_ENABLE=y
CONFIG_EBLI_OTA_ENABLE=y
CONFIG_EBLI_CONFIG_MANAGER_ENABLE=y
CONFIG_EBLI_SENSORS_ENABLED=y
CONFIG_EBLI_SENSORS_AHT10_ENABLED=y
CONFIG_EBLI_SENSORS_BATTERY_ENABLED=y
CONFIG_EBLI_SENSORS_SOILMOISTURE_ENABLED=y
CONFIG_EBLI_POWER_MANAGER_ENABLE=y
CONFIG_EBLI_DEBUG=y
```
